## base_external/Config.in
```kconfig
source "$BR2_EXTERNAL_project_base_PATH/package/aesd-assignments/Config.in"
source "$BR2_EXTERNAL_project_base_PATH/package/ldd/Config.in"
source "$BR2_EXTERNAL_project_base_PATH/package/aesd-char/Config.in"
source "$BR2_EXTERNAL_project_base_PATH/package/accelerometer-i2c/Config.in"
source "$BR2_EXTERNAL_project_base_PATH/package/gps-unified/Config.in"
```

## base_external/package/accelerometer-i2c/Config.in
```kconfig
config BR2_PACKAGE_ACCELEROMETER_I2C
	bool "accelerometer-i2c"
	help
	  Includes the i2c_userspace executable in the kernel image.
	  Used to understand buildroot external trees and package builds.
```

## base_external/package/aesd-char/Config.in
```kconfig
config BR2_PACKAGE_AESD_CHAR
	bool "aesd-char"
	help
	  Includes the AESD Char device module package.
```

## base_external/package/gps-unified/Config.in
```kconfig
config BR2_PACKAGE_GPS_UNIFIED
	bool "gps-unified"
	help
	  Includes the gps-unified executable in the kernel image.
	  Used to understand buildroot external trees and package builds.
```

## base_external/package/ldd/Config.in
```kconfig
config BR2_PACKAGE_LDD
	bool "ldd"
	help
	  Includes the misc-modules and scull in the kernel image.
```
